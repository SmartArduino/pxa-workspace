## firmware/boards/doit-esp32s31-devkit/sdkconfig.defaults
```kconfig
CONFIG_ESPTOOLPY_FLASHSIZE_8MB=y
CONFIG_PARTITION_TABLE_CUSTOM=y
CONFIG_PARTITION_TABLE_CUSTOM_FILENAME="boards/doit-esp32s31-devkit/partitions.csv"
CONFIG_PARTITION_TABLE_OFFSET=0x8000

CONFIG_SPIRAM=y
CONFIG_SPIRAM_USE_MALLOC=y
CONFIG_SPIRAM_SPEED_250M=y
CONFIG_SPIRAM_ALLOW_BSS_SEG_EXTERNAL_MEMORY=y
CONFIG_SPIRAM_ALLOW_NOINIT_SEG_EXTERNAL_MEMORY=y
CONFIG_SPIRAM_MALLOC_ALWAYSINTERNAL=4096
CONFIG_SPIRAM_MALLOC_RESERVE_INTERNAL=262144

CONFIG_COMPILER_OPTIMIZATION_PERF=y
CONFIG_ESP_MAIN_TASK_STACK_SIZE=16384
CONFIG_FREERTOS_HZ=1000
CONFIG_PXA_AUDIO_OUTPUT_TASK_AFFINITY=0
CONFIG_I2S_ISR_IRAM_SAFE=y

CONFIG_LITTLEFS_PAGE_SIZE=512
CONFIG_LITTLEFS_OBJ_NAME_LEN=192
CONFIG_LITTLEFS_READ_SIZE=256
CONFIG_LITTLEFS_WRITE_SIZE=256
CONFIG_LITTLEFS_LOOKAHEAD_SIZE=128
CONFIG_LITTLEFS_CACHE_SIZE=4096

CONFIG_LV_OS_FREERTOS=y
CONFIG_LV_USE_CLIB_STRING=y
CONFIG_LV_USE_CLIB_SPRINTF=y
CONFIG_LV_COLOR_DEPTH_16=y
CONFIG_LV_DEF_REFR_PERIOD=16
CONFIG_LV_DRAW_SW_DRAW_UNIT_CNT=1
CONFIG_LV_DRAW_THREAD_STACK_SIZE=32768
CONFIG_LV_DRAW_THREAD_PRIO=4
CONFIG_LV_DRAW_SW_SHADOW_CACHE_SIZE=24
CONFIG_LV_DRAW_BUF_ALIGN=64
CONFIG_LV_OBJ_STYLE_CACHE=y
CONFIG_LV_USE_GESTURE_RECOGNITION=y
CONFIG_LV_USE_FLOAT=y
CONFIG_LV_INDEV_DEF_GESTURE_ROTATION_THRESHOLD=150
CONFIG_LV_CACHE_DEF_SIZE=2097152
CONFIG_LV_IMAGE_HEADER_CACHE_DEF_CNT=32
CONFIG_LV_USE_FREETYPE=y
CONFIG_LV_FREETYPE_USE_LVGL_PORT=n
CONFIG_LV_FREETYPE_CACHE_FT_GLYPH_CNT=2048
CONFIG_LV_USE_SNAPSHOT=y
CONFIG_LV_FONT_MONTSERRAT_20=y
CONFIG_LV_BUILD_EXAMPLES=n
CONFIG_LV_BUILD_DEMOS=n


CONFIG_PXA_ENABLED=y
CONFIG_PXA_TRUST_BUNDLED_DEVELOPMENT_KEY=y
CONFIG_PXA_STORAGE_PARTITION_LABEL="pxa_data"
CONFIG_PXA_MOUNT_POINT="/pxa"
CONFIG_PXA_BUILTIN_PACKAGE_ROOT="system/pxa/factory"
CONFIG_PXA_STATE_ROOT="pxa-state"
CONFIG_PXA_WASI_LIBC=y
CONFIG_PXA_GUEST_STACK_SIZE=16384
CONFIG_PXA_HOST_MANAGED_HEAP_SIZE=16384
CONFIG_PXA_RUNTIME_TASK_STACK_SIZE=32768
CONFIG_PXA_RUNTIME_TASK_PRIORITY=3
CONFIG_PXA_RUNTIME_TASK_AFFINITY=1
CONFIG_PXA_CALL_TIMEOUT_MS=3000
CONFIG_PXA_PARALLEL_RASTER=y
CONFIG_PXA_RASTER_WORKER_AFFINITY=0
CONFIG_PXA_RASTER_WORKER_PRIORITY=4
CONFIG_PXA_RASTER_WORKER_STACK_SIZE=4096

CONFIG_WAMR_ENABLE_AOT=y
CONFIG_WAMR_ENABLE_INTERP=y
CONFIG_WAMR_ENABLE_LIB_PTHREAD=y
CONFIG_WAMR_ENABLE_LIBC_BUILTIN=y
CONFIG_WAMR_ENABLE_LIBC_WASI=y
CONFIG_WAMR_ENABLE_REF_TYPES=y
CONFIG_WAMR_ENABLE_SHARED_MEMORY=y
CONFIG_WAMR_LINEAR_MEMORY_IN_PSRAM=y
CONFIG_WAMR_AOT_CODE_IN_PSRAM=y

CONFIG_PXSYS_REFERENCE_UI=y
CONFIG_PXSYS_REFERENCE_UI_STATUS_BAR=y
CONFIG_PXSYS_REFERENCE_UI_WIFI=y
CONFIG_PXSYS_REFERENCE_UI_NOTIFICATION_SHADE=y
CONFIG_PXSYS_REFERENCE_UI_WALLPAPER=n
CONFIG_PXSYS_REFERENCE_UI_ANIMATIONS=y

CONFIG_PXADB_ENABLED=y
CONFIG_PXADB_AUTOSTART=y
CONFIG_PXADB_TRANSPORT_UART=y
CONFIG_PXADB_UART_PORT=0
CONFIG_PXADB_UART_BAUD=921600
CONFIG_UART_ISR_IN_IRAM=y
CONFIG_PXADB_TEST_CONTROL=y
CONFIG_ESP_CONSOLE_UART_BAUDRATE=921600
CONFIG_PXA_PRIVATE_FS_QUOTA_BYTES=8388608

CONFIG_ESP_CONSOLE_UART_DEFAULT=n
CONFIG_FATFS_LFN_HEAP=y
CONFIG_FATFS_MAX_LFN=255
CONFIG_FATFS_API_ENCODING_UTF_8=y
CONFIG_FATFS_USE_LABEL=y
CONFIG_FATFS_USE_FASTSEEK=y
CONFIG_FATFS_FAST_SEEK_BUFFER_SIZE=64
CONFIG_LIBC_PICOLIBC=n
CONFIG_LIBC_NEWLIB=y
CONFIG_ESP_DEFAULT_CPU_FREQ_MHZ_320=y
CONFIG_SPIRAM_MODE_OCT=y
CONFIG_SPIRAM_TRY_ALLOCATE_WIFI_LWIP=y
CONFIG_LWIP_IPV6=y
CONFIG_LV_USE_CUSTOM_MALLOC=y
CONFIG_MBEDTLS_EXTERNAL_MEM_ALLOC=y
CONFIG_PXSYS_REFERENCE_UI_BATTERY_PERCENT=n
CONFIG_PXSYS_REFERENCE_UI_NAVIGATION_BAR=y
CONFIG_PXSYS_REFERENCE_UI_LAUNCHER_COLUMNS=4
CONFIG_PXSYS_REFERENCE_UI_LAUNCHER_ROWS=5
CONFIG_CODEC_ES8311_SUPPORT=y
CONFIG_CODEC_ES8389_SUPPORT=n

# The default console choice fixes its baud at 115200 on current IDF.
CONFIG_ESP_CONSOLE_UART_CUSTOM=y
CONFIG_ESP_CONSOLE_UART_NUM=0
CONFIG_ESP_CONSOLE_UART_TX_GPIO=58
CONFIG_ESP_CONSOLE_UART_RX_GPIO=59
# WAMR dynamically relocates AOT into the PSRAM heap, which must execute.
CONFIG_SPIRAM_PRE_CONFIGURE_MEMORY_PROTECTION=n

CONFIG_PXADB_UART_TX_GPIO=58

CONFIG_PXADB_UART_RX_GPIO=59
CONFIG_LCD_RGB_ISR_IRAM_SAFE=y
```

## firmware/boards/doit-gamekit-1/Kconfig.projbuild
```kconfig
menu "DOIT GameKit 1"

config PXA_DOIT1_BATTERY_R37_KOHM
    int "Battery divider upper resistor R37 (kohm)"
    range 1 1000
    default 100
    help
        Must match the physical resistor between BAT+ and GPIO49.
        V0.8 uses 100 kohm. With R52=100 kohm, a full 4.2 V cell exceeds
        the S31 ADC's approximately 2 V range. Replacing R37 with 120 kohm
        and setting this to 120 keeps the full cell voltage in range.

config PXA_DOIT1_BATTERY_R52_KOHM
    int "Battery divider lower resistor R52 (kohm)"
    range 1 1000
    default 100
    help
        Must match the physical resistor between GPIO49 and ground.

config PXA_DOIT1_TOUCH
    bool "FT6336U capacitive touch"
    default y
    help
        Poll the module at I2C address 0x38 on GPIO13/14, INT=15, RESET=16.
        Match the reference firmware: swap XY, then mirror Y for the default software rotation.

config PXA_DOIT1_LCD_PSRAM_DMA_DIRECT
    bool "Send aligned output frames directly from PSRAM"
    default y
    help
        Use SPI DMA on the cache-aligned PSRAM output frame, without internal
        bounce copies. The submit worker drains DMA before recycling a frame.
        Disable to use four-line internal bounce buffers for troubleshooting.

config PXA_DOIT1_LCD_CLOCK_HZ
    int "LCD SPI clock (Hz)"
    range 10000000 80000000
    default 80000000

config PXA_DOIT1_LCD_FLIP_180
    bool "Rotate landscape orientation by 180 degrees"
    default n
    help
        The panel keeps native 240x320 addressing (MADCTL MV/MX/MY cleared).
        Default software rotation is 270 degrees; select 90 degrees instead.
        The FT6336U coordinate transform changes together with the display.

config PXA_DOIT1_LCD_INVERT
    bool "Invert LCD colors"
    default n

config PXA_DOIT1_LCD_BGR
    bool "Use BGR panel color order"
    default n

config PXA_DOIT1_LCD_X_GAP
    int "Native portrait panel X offset (pixels)"
    range 0 80
    default 0

config PXA_DOIT1_LCD_Y_GAP
    int "Native portrait panel Y offset (pixels)"
    range 0 80
    default 0

config PXA_DOIT1_DENSITY_DPI
    int "Display density (DPI)"
    range 80 500
    default 125
    help
        Approximately 125 DPI for a 320x240 panel with a 65x50 mm active area.
        Keep the simulator profile at the same density.

endmenu
```

## firmware/boards/doit-gamekit-2/Kconfig.projbuild
```kconfig
menu "DOIT GameKit 2"

config PXA_DOIT2_BATTERY_R37_KOHM
    int "Battery divider upper resistor R37 (kohm)"
    range 1 1000
    default 120
    help
        Must match R37 between VBAT_SW and GPIO49. V2.0 uses 120 kohm,
        with R52=100 kohm and C50=100 nF. Q5/Q6 enable the divider in hardware.

config PXA_DOIT2_BATTERY_R52_KOHM
    int "Battery divider lower resistor R52 (kohm)"
    range 1 1000
    default 100
    help
        Must match the physical resistor between GPIO49 and ground.

config PXA_DOIT2_BATTERY_GAIN_PERMILLE
    int "Battery voltage correction gain (per mille)"
    range 500 1500
    default 1089
    help
        V2.0 reference measurement: multiply the restored divider voltage
        by 1089/1000, then add BATTERY_OFFSET_MV. Set 1000 for unity gain.

config PXA_DOIT2_BATTERY_OFFSET_MV
    int "Battery voltage correction offset (mV)"
    range -1000 1000
    default 127
    help
        Added after divider restoration and gain correction. Set 0 to disable.

config PXA_DOIT2_TOUCH
    bool "FT6336U capacitive touch"
    default y
    help
        Poll the module at I2C address 0x38 on GPIO13/14, INT=15, RESET=16.
        Match the reference firmware: swap XY, then mirror Y for the default software rotation.

config PXA_DOIT2_LCD_PSRAM_DMA_DIRECT
    bool "Send aligned output frames directly from PSRAM"
    default y
    help
        Use SPI DMA on the cache-aligned PSRAM output frame, without internal
        bounce copies. The submit worker drains DMA before recycling a frame.
        Disable to use four-line internal bounce buffers for troubleshooting.

config PXA_DOIT2_LCD_CLOCK_HZ
    int "LCD SPI clock (Hz)"
    range 10000000 80000000
    default 80000000

config PXA_DOIT2_LCD_FLIP_180
    bool "Rotate landscape orientation by 180 degrees"
    default n
    help
        The panel keeps native 240x320 addressing (MADCTL MV/MX/MY cleared).
        Default software rotation is 270 degrees; select 90 degrees instead.
        The FT6336U coordinate transform changes together with the display.

config PXA_DOIT2_LCD_INVERT
    bool "Invert LCD colors"
    default n

config PXA_DOIT2_LCD_BGR
    bool "Use BGR panel color order"
    default n

config PXA_DOIT2_LCD_X_GAP
    int "Native portrait panel X offset (pixels)"
    range 0 80
    default 0

config PXA_DOIT2_LCD_Y_GAP
    int "Native portrait panel Y offset (pixels)"
    range 0 80
    default 0

config PXA_DOIT2_DENSITY_DPI
    int "Display density (DPI)"
    range 80 500
    default 125
    help
        Approximately 125 DPI for a 320x240 panel with a 65x50 mm active area.
        Keep the simulator profile at the same density.

endmenu
```

## firmware/boards/doit-gamekit/Kconfig.projbuild
```kconfig
menu "DOIT GameKit"

config PXA_DOIT_LCD_PSRAM_DMA_DIRECT
    bool "Send aligned output frames directly from PSRAM"
    default y
    help
        Use SPI DMA on the cache-aligned PSRAM output frame, without internal
        bounce copies. The submit worker drains DMA before recycling a frame.
        Disable to use four-line internal bounce buffers for troubleshooting.

config PXA_DOIT_LCD_CLOCK_HZ
    int "ST7789 SPI clock (Hz)"
    range 10000000 80000000
    default 80000000

choice PXA_DOIT_LCD_SOFTWARE_ROTATION
    prompt "Landscape software rotation"
    default PXA_DOIT_LCD_ROTATE_270
    help
        Keep ST7789 in native 240x320 scan order. Rotate a complete logical
        320x240 frame in software before sending it. No panel axis swap or
        mirror commands are used for landscape. There is no TE connection.

config PXA_DOIT_LCD_ROTATE_270
    bool "270 degrees (default board orientation)"

config PXA_DOIT_LCD_ROTATE_90
    bool "90 degrees (upside down)"

endchoice

config PXA_DOIT_LCD_INVERT
    bool "Invert ST7789 colors"
    default y

config PXA_DOIT_LCD_BGR
    bool "Use BGR panel color order"
    default n

config PXA_DOIT_LCD_X_GAP
    int "Native portrait panel X offset (pixels)"
    range 0 80
    default 0

config PXA_DOIT_LCD_Y_GAP
    int "Native portrait panel Y offset (pixels)"
    range 0 80
    default 0

config PXA_DOIT_DENSITY_DPI
    int "Display density (DPI)"
    range 80 500
    default 125
    help
        Approximately 125 DPI for a 320x240 panel with a 65x50 mm active area.
        Keep the simulator profile at the same density.

endmenu
```

## firmware/boards/epdiy-v7/Kconfig.projbuild
```kconfig
menu "EPDiy V7 40-pin"
choice PXA_EPDIY_ORIENTATION
    prompt "Screen orientation"
    default PXA_EPDIY_PORTRAIT
config PXA_EPDIY_PORTRAIT
    bool "Portrait (684 x 1216, clockwise)"
config PXA_EPDIY_LANDSCAPE
    bool "Landscape (1216 x 684)"
endchoice
config PXA_EPDIY_VCOM_MV
    int "Panel VCOM magnitude (mV; use the value on the panel label)"
    range 0 5110
    default 1200
config PXA_EPDIY_REFRESH_MS
    int "Minimum interval between physical refreshes (ms)"
    range 100 10000
    default 350
config PXA_EPDIY_CLEAN_EVERY
    int "Full clear after this many partial updates"
    range 1 1000
    default 20
config PXA_EPDIY_GC16_PERCENT
    int "Use GC16 when changed pixels reach this screen percentage"
    range 1 100
    default 40
config PXA_EPDIY_FAST_MONO
    bool "Use DU for transitions between pure black and pure white"
    default y
config PXA_EPDIY_DITHER
    bool "Ordered 4-bit grayscale dithering (photos)"
    default n
config PXA_EPDIY_DENSITY_DPI
    int "Logical display density (DPI)"
    range 72 600
    default 300
config PXA_EPDIY_FRONTLIGHT
    bool "Warm/cool frontlight on GPIO3/GPIO46 (reference wiring)"
    default n
config PXA_EPDIY_FRONTLIGHT_WARM_PERCENT
    int "Warm channel percentage of total brightness"
    depends on PXA_EPDIY_FRONTLIGHT
    range 0 100
    default 50
config PXA_EPDIY_WIFI
    bool "Wi-Fi provisioning and networking"
    default y
endmenu
```
