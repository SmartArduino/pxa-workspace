## firmware/components/pxa_system_reference_ui/Kconfig
```kconfig
menu "PXA System UI selection"

    config PXSYS_REFERENCE_UI
        bool "Use reference UI instead of product legacy UI"
        default n
        help
            Selects the standard PXA System Home, Settings, status bar and
            navigation implementations. The ESP product defaults to its legacy
            app_pages UI while retaining the PXA System services, renderer and
            runtime beneath it. Enable this only to evaluate or migrate to the
            reference presentation.

    config PXSYS_REFERENCE_UI_STATUS_BAR
        bool "Standard status bar"
        default y
        depends on PXSYS_REFERENCE_UI

    config PXSYS_REFERENCE_UI_WIFI
        bool "Wi-Fi status and settings"
        default y
        depends on PXSYS_REFERENCE_UI

    config PXSYS_REFERENCE_UI_CELLULAR
        bool "Cellular status and settings"
        default y
        depends on PXSYS_REFERENCE_UI

    config PXSYS_REFERENCE_UI_BATTERY_PERCENT
        bool "Numeric battery percentage"
        default y
        depends on PXSYS_REFERENCE_UI_STATUS_BAR
        help
            Show battery percentage text in the status bar and notification
            shade. The battery icon remains available when this is disabled.

    config PXSYS_REFERENCE_UI_NAVIGATION_BAR
        bool "Standard navigation bar"
        default y
        depends on PXSYS_REFERENCE_UI

    choice PXSYS_REFERENCE_UI_NAVIGATION_MODE
        prompt "Standard navigation mode"
        default PXSYS_REFERENCE_UI_NAVIGATION_BUTTONS
        depends on PXSYS_REFERENCE_UI_NAVIGATION_BAR

        config PXSYS_REFERENCE_UI_NAVIGATION_BUTTONS
            bool "Back button"

        config PXSYS_REFERENCE_UI_NAVIGATION_GESTURES
            bool "Edge Back and bottom-swipe Home gestures"
    endchoice

    config PXSYS_REFERENCE_UI_GESTURE_HANDLE
        bool "Gesture navigation indicator"
        default n
        depends on PXSYS_REFERENCE_UI_NAVIGATION_GESTURES
        help
            Draw the bottom gesture handle and reserve space above it. The
            bottom gesture target remains active when this is disabled.

    config PXSYS_REFERENCE_UI_LAUNCHER_COLUMNS
        int "Launcher app columns per page"
        range 1 8
        default 4
        depends on PXSYS_REFERENCE_UI

    config PXSYS_REFERENCE_UI_LAUNCHER_ROWS
        int "Launcher app rows per page"
        range 1 8
        default 2
        depends on PXSYS_REFERENCE_UI
        help
            The launcher is horizontally paged. Each page contains columns
            multiplied by rows applications.

    config PXSYS_REFERENCE_UI_NOTIFICATION_SHADE
        bool "Standard notification shade"
        default y
        depends on PXSYS_REFERENCE_UI_STATUS_BAR

    config PXSYS_REFERENCE_UI_WALLPAPER
        bool "Standard Home wallpaper"
        default y
        depends on PXSYS_REFERENCE_UI
        help
            Includes the adaptive reference wallpaper. Disable this to remove
            the wallpaper code and render Home on the theme background only.

    config PXSYS_REFERENCE_UI_ANIMATIONS
        bool "System UI animations"
        default y
        depends on PXSYS_REFERENCE_UI
        help
            Compiles gesture, Home and task-switcher animations. Disable this
            to remove their code; animations can also be disabled at runtime.

    choice PXSYS_REFERENCE_UI_TASK_SWITCHER_MODE
        prompt "Recent-task presentation"
        default PXSYS_REFERENCE_UI_TASK_SWITCHER_CARDS
        depends on PXSYS_REFERENCE_UI

        config PXSYS_REFERENCE_UI_TASK_SWITCHER_CARDS
            bool "Live-preview cards"
            depends on LV_USE_SNAPSHOT
            help
                Keeps a bounded RGB565 snapshot cache and presents recent apps
                as horizontally scrolling cards.

        config PXSYS_REFERENCE_UI_TASK_SWITCHER_LIST
            bool "Low-memory list"
            help
                Does not capture app surfaces and uses a compact text list.
    endchoice

    config PXSYS_REFERENCE_UI_TASK_PREVIEW_COUNT
        int "Cached recent-task previews"
        range 1 8
        default 4
        depends on PXSYS_REFERENCE_UI_TASK_SWITCHER_CARDS

endmenu
```

## firmware/components/pxadb/Kconfig
```kconfig
menu "PXADB development service"

    config PXADB_ENABLED
        bool "Enable PXADB development service"
        depends on IDF_TARGET_ESP32S3 || IDF_TARGET_ESP32S31
        default n
        help
            Expose PXADB control, PXA package management, filesystem access
            and structured logs over the selected transport. It does not
            expose a shell or raw flash access.

    choice PXADB_TRANSPORT
        prompt "PXADB transport"
        depends on PXADB_ENABLED
        default PXADB_TRANSPORT_USB_SERIAL_JTAG
        help
            USB Serial/JTAG is the ESP32-S3 native port. Boards whose native
            USB port is not wired (the service is tunnelled through a USB-UART
            bridge instead) can run PXADB over a UART. With a UART transport,
            console log text shares the same line and the host client skips
            lines that are not PXADB frames.

        config PXADB_TRANSPORT_USB_SERIAL_JTAG
            bool "USB Serial/JTAG"

        config PXADB_TRANSPORT_UART
            bool "UART"
    endchoice

    config PXADB_UART_PORT
        int "PXADB UART port"
        range 0 2
        default 0
        depends on PXADB_ENABLED && PXADB_TRANSPORT_UART

    config PXADB_UART_TX_GPIO
        int "PXADB UART TX GPIO (-1 keeps the console default)"
        default -1
        depends on PXADB_ENABLED && PXADB_TRANSPORT_UART

    config PXADB_UART_RX_GPIO
        int "PXADB UART RX GPIO (-1 keeps the console default)"
        default -1
        depends on PXADB_ENABLED && PXADB_TRANSPORT_UART

    config PXADB_UART_BAUD
        int "PXADB UART baud rate"
        default 115200
        depends on PXADB_ENABLED && PXADB_TRANSPORT_UART

    config PXADB_AUTOSTART
        bool "Start PXADB automatically after boot"
        depends on PXADB_ENABLED
        default n
        help
            Start PXADB from a bounded background retry task after platform
            initialization. Keep this disabled in production firmware.

    config PXADB_TEST_CONTROL
        bool "Enable input injection and display capture"
        depends on PXADB_ENABLED
        default n
        help
            Enable logical input injection and RGB565 capture commands. The
            product must configure a pxadb::TestControlAdapter before starting
            the service; unavailable controls are not advertised to the host.

    config PXADB_CAPTURE_MIN_INTERVAL_MS
        int "Minimum interval between screenshot captures (ms)"
        range 0 10000
        default 250
        depends on PXADB_TEST_CONTROL
        help
            Screenshot requests faster than this are rejected with
            screenshot_rate_limited. Device-encoded JPEG captures are much
            cheaper than RGB565 bursts, so a lower value gives a smoother
            preview when the host asks for JPEG frames.

endmenu
```

## tools/aot-native-bench/sdkconfig.defaults
```kconfig
CONFIG_ESPTOOLPY_FLASHSIZE_16MB=y
CONFIG_COMPILER_OPTIMIZATION_PERF=y
CONFIG_COMPILER_LTO_LINKTIME=n
CONFIG_FREERTOS_HZ=1000
CONFIG_ESP_MAIN_TASK_STACK_SIZE=8192
CONFIG_SPIRAM=y
CONFIG_SPIRAM_MODE_OCT=y
CONFIG_SPIRAM_USE_MALLOC=y
CONFIG_SPIRAM_MALLOC_ALWAYSINTERNAL=0
CONFIG_SPIRAM_MALLOC_RESERVE_INTERNAL=65536
CONFIG_SPIRAM_PRE_CONFIGURE_MEMORY_PROTECTION=n
CONFIG_WAMR_BUILD_RELEASE=y
CONFIG_WAMR_ENABLE_AOT=y
CONFIG_WAMR_ENABLE_INTERP=y
CONFIG_WAMR_ENABLE_LIB_PTHREAD=y
CONFIG_WAMR_ENABLE_LIBC_BUILTIN=y
CONFIG_WAMR_ENABLE_LIBC_WASI=n
CONFIG_WAMR_ENABLE_REF_TYPES=y
CONFIG_WAMR_ENABLE_SHARED_MEMORY=y
CONFIG_WAMR_LINEAR_MEMORY_IN_PSRAM=y
CONFIG_WAMR_LINEAR_MEMORY_RESERVE_MAX=y
CONFIG_WAMR_ENABLE_DUMP_CALL_STACK=y
```

## tools/aot-native-bench/sdkconfig.defaults.esp32s3
```kconfig
CONFIG_ESP_DEFAULT_CPU_FREQ_MHZ_240=y
CONFIG_SPIRAM_SPEED_80M=y
CONFIG_ESP_CONSOLE_USB_SERIAL_JTAG=y
CONFIG_ESP_CONSOLE_SECONDARY_NONE=y
CONFIG_WAMR_AOT_CODE_IN_PSRAM=y
CONFIG_ESP32S3_INSTRUCTION_CACHE_16KB=y
CONFIG_ESP32S3_INSTRUCTION_CACHE_LINE_32B=y
CONFIG_ESP32S3_DATA_CACHE_32KB=y
CONFIG_ESP32S3_DATA_CACHE_LINE_64B=y
```

## tools/aot-native-bench/sdkconfig.defaults.esp32s31
```kconfig
CONFIG_ESP_DEFAULT_CPU_FREQ_MHZ_320=y
CONFIG_SPIRAM_SPEED_250M=y
CONFIG_ESP_CONSOLE_UART_DEFAULT=y
CONFIG_ESP_CONSOLE_UART_BAUDRATE=115200
CONFIG_ESP_CONSOLE_SECONDARY_USB_SERIAL_JTAG=y
CONFIG_WAMR_AOT_CODE_IN_PSRAM=y
```
