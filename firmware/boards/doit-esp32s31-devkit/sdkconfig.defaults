## firmware/boards/epdiy-v7/sdkconfig.defaults
```kconfig
CONFIG_IDF_TARGET_ESP32S3=y
CONFIG_ESPTOOLPY_FLASHSIZE_16MB=y
CONFIG_ESPTOOLPY_FLASHMODE_QIO=y
CONFIG_ESP_DEFAULT_CPU_FREQ_MHZ_240=y
CONFIG_PARTITION_TABLE_CUSTOM=y
CONFIG_PARTITION_TABLE_CUSTOM_FILENAME="boards/epdiy-v7/partitions.csv"
CONFIG_PARTITION_TABLE_OFFSET=0x8000
CONFIG_SPIRAM=y
CONFIG_SPIRAM_MODE_OCT=y
CONFIG_SPIRAM_SPEED_80M=y
CONFIG_SPIRAM_USE_MALLOC=y
CONFIG_SPIRAM_MALLOC_ALWAYSINTERNAL=0
CONFIG_SPIRAM_MALLOC_RESERVE_INTERNAL=131072
CONFIG_SPIRAM_TRY_ALLOCATE_WIFI_LWIP=y
# LCD DMA/queues and task stacks need internal SRAM; HTTPS buffers do not.
CONFIG_MBEDTLS_EXTERNAL_MEM_ALLOC=y
CONFIG_SPIRAM_ALLOW_BSS_SEG_EXTERNAL_MEMORY=y
CONFIG_ESP32S3_INSTRUCTION_CACHE_32KB=y
CONFIG_ESP32S3_DATA_CACHE_32KB=y
CONFIG_ESP32S3_DATA_CACHE_LINE_64B=y
CONFIG_COMPILER_OPTIMIZATION_PERF=y
CONFIG_COMPILER_CXX_EXCEPTIONS=y
CONFIG_COMPILER_CXX_RTTI=y
CONFIG_ESP_MAIN_TASK_STACK_SIZE=16384
CONFIG_FREERTOS_HZ=1000
CONFIG_ESP_SYSTEM_EVENT_TASK_STACK_SIZE=4096
CONFIG_ESP_WIFI_STATIC_RX_BUFFER_NUM=4
CONFIG_ESP_WIFI_DYNAMIC_RX_BUFFER_NUM=6
CONFIG_ESP_WIFI_STATIC_TX_BUFFER_NUM=6
CONFIG_ESP_WIFI_RX_BA_WIN=6
CONFIG_ESP_WIFI_MGMT_SBUF_NUM=32
CONFIG_LITTLEFS_PAGE_SIZE=512
CONFIG_LITTLEFS_OBJ_NAME_LEN=192
CONFIG_LITTLEFS_READ_SIZE=256
CONFIG_LITTLEFS_WRITE_SIZE=256
CONFIG_LITTLEFS_LOOKAHEAD_SIZE=128
CONFIG_LITTLEFS_CACHE_SIZE=4096
CONFIG_LITTLEFS_MALLOC_STRATEGY_SPIRAM_PREFER=y
CONFIG_LV_OS_FREERTOS=y
CONFIG_LV_USE_CUSTOM_MALLOC=y
CONFIG_LV_USE_CLIB_STRING=y
CONFIG_LV_USE_CLIB_SPRINTF=y
CONFIG_LV_COLOR_DEPTH_16=y
CONFIG_LV_DEF_REFR_PERIOD=100
CONFIG_LV_DRAW_SW_DRAW_UNIT_CNT=1
CONFIG_LV_DRAW_THREAD_STACK_SIZE=32768
CONFIG_LV_DRAW_THREAD_PRIO=4
CONFIG_LV_DRAW_BUF_ALIGN=64
CONFIG_LV_USE_FLOAT=y
CONFIG_LV_CACHE_DEF_SIZE=524288
CONFIG_LV_IMAGE_HEADER_CACHE_DEF_CNT=16
CONFIG_LV_USE_FREETYPE=y
CONFIG_LV_FREETYPE_USE_LVGL_PORT=n
CONFIG_LV_FREETYPE_CACHE_FT_GLYPH_CNT=256
CONFIG_LV_USE_SNAPSHOT=y
CONFIG_LV_FONT_MONTSERRAT_20=y
CONFIG_LV_FONT_MONTSERRAT_18=y
CONFIG_LV_FONT_MONTSERRAT_24=y
CONFIG_LV_BUILD_EXAMPLES=n
CONFIG_LV_BUILD_DEMOS=n
CONFIG_PXA_ENABLED=y
CONFIG_PXA_TRUST_BUNDLED_DEVELOPMENT_KEY=y
CONFIG_PXA_STORAGE_PARTITION_LABEL="pxa_data"
CONFIG_PXA_MOUNT_POINT="/pxa"
# Provision data through pxadb or a factory image; never erase it on failure.
# CONFIG_PXA_STORAGE_FORMAT_IF_MOUNT_FAILED is not set
CONFIG_PXA_BUILTIN_PACKAGE_ROOT="system/pxa/factory"
CONFIG_PXA_STATE_ROOT="pxa-state"
CONFIG_PXA_WASI_LIBC=y
CONFIG_PXA_GUEST_STACK_SIZE=16384
CONFIG_PXA_HOST_MANAGED_HEAP_SIZE=16384
CONFIG_PXA_RUNTIME_TASK_STACK_SIZE=16384
CONFIG_PXA_RUNTIME_TASK_PRIORITY=3
CONFIG_PXA_RUNTIME_TASK_AFFINITY=1
CONFIG_PXA_RASTER_INTERNAL_ALLOCATION_MAX_BYTES=4096
CONFIG_PXA_CALL_TIMEOUT_MS=3000
CONFIG_PXA_PRIVATE_FS_QUOTA_BYTES=8388608
CONFIG_WAMR_ENABLE_AOT=y
CONFIG_WAMR_ENABLE_INTERP=y
CONFIG_WAMR_ENABLE_LIB_PTHREAD=y
CONFIG_WAMR_ENABLE_LIBC_BUILTIN=y
CONFIG_WAMR_ENABLE_LIBC_WASI=y
CONFIG_WAMR_ENABLE_REF_TYPES=y
CONFIG_WAMR_ENABLE_SHARED_MEMORY=y
CONFIG_WAMR_LINEAR_MEMORY_IN_PSRAM=y
CONFIG_WAMR_AOT_CODE_IN_PSRAM=y
CONFIG_PXSYS_REFERENCE_UI=y
CONFIG_PXSYS_REFERENCE_UI_STATUS_BAR=y
CONFIG_PXSYS_REFERENCE_UI_WIFI=y
CONFIG_PXSYS_REFERENCE_UI_BATTERY_PERCENT=n
CONFIG_PXSYS_REFERENCE_UI_NAVIGATION_BAR=y
CONFIG_PXSYS_REFERENCE_UI_NAVIGATION_GESTURES=y
CONFIG_PXSYS_REFERENCE_UI_GESTURE_HANDLE=y
CONFIG_PXSYS_REFERENCE_UI_LAUNCHER_COLUMNS=3
CONFIG_PXSYS_REFERENCE_UI_LAUNCHER_ROWS=4
CONFIG_PXSYS_REFERENCE_UI_NOTIFICATION_SHADE=y
CONFIG_PXSYS_REFERENCE_UI_WALLPAPER=n
# CONFIG_PXSYS_REFERENCE_UI_ANIMATIONS is not set
# UART0 is independent of the LCD_CAM pins (USB D-/D+ also remain free).
CONFIG_ESP_CONSOLE_UART_CUSTOM=y
CONFIG_ESP_CONSOLE_UART_CUSTOM_NUM_0=y
CONFIG_ESP_CONSOLE_UART_TX_GPIO=43
CONFIG_ESP_CONSOLE_UART_RX_GPIO=44
CONFIG_ESP_CONSOLE_UART_BAUDRATE=921600
CONFIG_ESPTOOLPY_MONITOR_BAUD=921600
CONFIG_PXADB_ENABLED=y
CONFIG_PXADB_AUTOSTART=y
CONFIG_PXADB_TEST_CONTROL=y
CONFIG_PXADB_TRANSPORT_UART=y
CONFIG_PXADB_UART_PORT=0
CONFIG_PXADB_UART_BAUD=921600
CONFIG_UART_ISR_IN_IRAM=y
CONFIG_PXADB_TASK_STACK_SIZE=18432
CONFIG_PXADB_JPEG_PSRAM_WORKSPACE=y
```

## firmware/boards/esp-mosaico/Kconfig.projbuild
```kconfig
menu "ESP-Mosaico peripherals"

config PXA_MOSAICO_LCD_PSRAM_DMA_DIRECT
    bool "Send contiguous output rows directly from PSRAM"
    default y
    help
        Reuse aligned, immutable scanout rows as SPI DMA input, as on
        DOIT GameKit 1. Narrow strided windows retain internal staging.
        Disable to use the original two internal staging buffers throughout.

config PXA_MOSAICO_NAND_FORMAT_IF_MOUNT_FAILED
    bool "Automatically initialize onboard NAND without a filesystem"
    default y
    help
        On startup, probe the onboard NAND and create a Dhara-backed FAT
        filesystem when FatFS reports FR_NO_FILESYSTEM. This erases existing
        content not recognized as a FAT filesystem. Valid filesystems mount
        directly. I/O failures and other probe errors do not trigger a format.
        Disable this option to preserve unrecognized NAND content.

endmenu
```

## firmware/boards/esp32s31-korvo-1/sdkconfig.defaults
```kconfig
CONFIG_IDF_TARGET_ESP32S31=y
CONFIG_ESPTOOLPY_FLASHSIZE_16MB=y
CONFIG_PARTITION_TABLE_CUSTOM=y
CONFIG_PARTITION_TABLE_CUSTOM_FILENAME="boards/esp32s31-korvo-1/partitions.csv"
CONFIG_PARTITION_TABLE_OFFSET=0x8000

CONFIG_SPIRAM=y
CONFIG_SPIRAM_USE_MALLOC=y
CONFIG_SPIRAM_SPEED_250M=y
# WAMR relocates AOT text into the PSRAM heap at runtime. On ESP32-S31 the
# preconfigured PMP layout locks that heap RW, which faults on AOT execution.
# CONFIG_SPIRAM_PRE_CONFIGURE_MEMORY_PROTECTION is not set
CONFIG_SPIRAM_ALLOW_BSS_SEG_EXTERNAL_MEMORY=y
CONFIG_SPIRAM_ALLOW_NOINIT_SEG_EXTERNAL_MEMORY=y
CONFIG_SPIRAM_MALLOC_ALWAYSINTERNAL=0
CONFIG_SPIRAM_MALLOC_RESERVE_INTERNAL=262144

CONFIG_COMPILER_OPTIMIZATION_PERF=y
CONFIG_ESP_MAIN_TASK_STACK_SIZE=16384
CONFIG_FREERTOS_HZ=1000

CONFIG_LITTLEFS_PAGE_SIZE=512
CONFIG_LITTLEFS_OBJ_NAME_LEN=96
CONFIG_LITTLEFS_READ_SIZE=256
CONFIG_LITTLEFS_WRITE_SIZE=256
CONFIG_LITTLEFS_LOOKAHEAD_SIZE=128
CONFIG_LITTLEFS_CACHE_SIZE=4096

CONFIG_LV_OS_FREERTOS=y
CONFIG_LV_USE_CLIB_MALLOC=y
CONFIG_LV_USE_CLIB_STRING=y
CONFIG_LV_USE_CLIB_SPRINTF=y
CONFIG_LV_COLOR_DEPTH_16=y
CONFIG_LV_DEF_REFR_PERIOD=16
CONFIG_LV_DRAW_SW_DRAW_UNIT_CNT=2
CONFIG_LV_DRAW_THREAD_STACK_SIZE=32768
CONFIG_LV_DRAW_THREAD_PRIO=4
CONFIG_LV_DRAW_SW_SHADOW_CACHE_SIZE=24
CONFIG_LV_DRAW_BUF_ALIGN=64
CONFIG_LV_OBJ_STYLE_CACHE=y
CONFIG_LV_USE_GESTURE_RECOGNITION=y
CONFIG_LV_USE_FLOAT=y
CONFIG_LV_INDEV_DEF_GESTURE_ROTATION_THRESHOLD=150
CONFIG_LV_CACHE_DEF_SIZE=4194304
CONFIG_LV_IMAGE_HEADER_CACHE_DEF_CNT=32
# Keep LVGL's small UI primitives on the two software draw workers.  The PPA
# renderer performs synchronous cache maintenance for every operation on the
# PSRAM framebuffer, which is slower for the settings list's many small fills.
# CONFIG_LV_USE_PPA is not set
CONFIG_LV_USE_FREETYPE=y
CONFIG_LV_FREETYPE_USE_LVGL_PORT=n
CONFIG_LV_FREETYPE_CACHE_FT_GLYPH_CNT=2048
# CONFIG_LV_USE_LODEPNG is not set
CONFIG_LV_USE_SNAPSHOT=y
CONFIG_LV_FONT_MONTSERRAT_20=y
CONFIG_LV_BUILD_EXAMPLES=n
CONFIG_LV_BUILD_DEMOS=n

CONFIG_CODEC_I2C_BACKWARD_COMPATIBLE=n
CONFIG_CODEC_ES8389_SUPPORT=y
CONFIG_ESP_LCD_TOUCH_MAX_POINTS=5

CONFIG_PXA_ENABLED=y
CONFIG_PXA_TRUST_BUNDLED_DEVELOPMENT_KEY=y
CONFIG_PXA_STORAGE_PARTITION_LABEL="pxa_data"
CONFIG_PXA_MOUNT_POINT="/pxa"
CONFIG_PXA_STORAGE_FORMAT_IF_MOUNT_FAILED=y
CONFIG_PXA_BUILTIN_PACKAGE_ROOT="system/pxa/factory"
CONFIG_PXA_STATE_ROOT="pxa-state"
CONFIG_PXA_WASI_LIBC=y
CONFIG_PXA_GUEST_STACK_SIZE=16384
CONFIG_PXA_HOST_MANAGED_HEAP_SIZE=16384
CONFIG_PXA_RUNTIME_TASK_STACK_SIZE=12288
CONFIG_PXA_RUNTIME_TASK_PRIORITY=3
CONFIG_PXA_RUNTIME_TASK_AFFINITY=1
CONFIG_PXA_CALL_TIMEOUT_MS=3000
CONFIG_PXA_PARALLEL_RASTER=y
CONFIG_PXA_RASTER_WORKER_AFFINITY=0
CONFIG_PXA_RASTER_WORKER_PRIORITY=4
CONFIG_PXA_RASTER_WORKER_STACK_SIZE=4096

CONFIG_WAMR_ENABLE_AOT=y
CONFIG_WAMR_ENABLE_INTERP=y
CONFIG_WAMR_ENABLE_LIB_PTHREAD=y
CONFIG_WAMR_ENABLE_LIBC_BUILTIN=y
CONFIG_WAMR_ENABLE_LIBC_WASI=y
CONFIG_WAMR_ENABLE_REF_TYPES=y
CONFIG_WAMR_ENABLE_SHARED_MEMORY=y
CONFIG_WAMR_LINEAR_MEMORY_IN_PSRAM=y
CONFIG_WAMR_AOT_CODE_IN_PSRAM=y

CONFIG_PXSYS_REFERENCE_UI=y
CONFIG_PXSYS_REFERENCE_UI_STATUS_BAR=y
CONFIG_PXSYS_REFERENCE_UI_WIFI=y
CONFIG_PXSYS_REFERENCE_UI_BATTERY_PERCENT=n
CONFIG_PXSYS_REFERENCE_UI_NAVIGATION_BAR=y
CONFIG_PXSYS_REFERENCE_UI_NAVIGATION_GESTURES=y
CONFIG_PXSYS_REFERENCE_UI_GESTURE_HANDLE=y
CONFIG_PXSYS_REFERENCE_UI_LAUNCHER_COLUMNS=4
CONFIG_PXSYS_REFERENCE_UI_LAUNCHER_ROWS=2
CONFIG_PXSYS_REFERENCE_UI_NOTIFICATION_SHADE=y
CONFIG_PXSYS_REFERENCE_UI_WALLPAPER=n
CONFIG_PXSYS_REFERENCE_UI_ANIMATIONS=y

CONFIG_PXADB_ENABLED=y
CONFIG_PXADB_AUTOSTART=y
CONFIG_PXADB_TRANSPORT_UART=y
CONFIG_PXADB_UART_PORT=0
CONFIG_PXADB_UART_BAUD=2000000
CONFIG_ESP_CONSOLE_UART_BAUDRATE=2000000
```

## firmware/boards/espp4-a/tests/sd_probe_fw/sdkconfig.defaults
```kconfig
CONFIG_IDF_TARGET="esp32p4"
CONFIG_ESP32P4_REV_MIN_301=y
CONFIG_ESPTOOLPY_FLASHSIZE_16MB=y
CONFIG_ESP_DEFAULT_CPU_FREQ_MHZ_400=y
CONFIG_SPIRAM=y
CONFIG_SPIRAM_MODE_HEX=y
CONFIG_SPIRAM_SPEED_250M=y
CONFIG_CACHE_L2_CACHE_128KB=y
CONFIG_CACHE_L2_CACHE_LINE_128B=y
CONFIG_FREERTOS_HZ=1000
CONFIG_ESP_CONSOLE_UART_BAUDRATE=2000000
CONFIG_ESP_CONSOLE_UART_CUSTOM=y
CONFIG_ESP_CONSOLE_UART_TX_GPIO=37
CONFIG_ESP_CONSOLE_UART_RX_GPIO=38
CONFIG_SD_ENABLE_SDIO_SUPPORT=n
CONFIG_FATFS_LFN_HEAP=y
CONFIG_FATFS_MAX_LFN=255
CONFIG_VFS_SUPPORT_DIR=y
CONFIG_COMPILER_OPTIMIZATION_PERF=y
```

## firmware/boards/espp4-a/vendor/p4_wireless/Kconfig
```kconfig
menu "P4 Wireless (ESPP4-A)"

    config P4_WIRELESS
        bool
        default y

    # Fixed by the prebuilt library, do not change
    if !ESP_WIFI_REMOTE_IN_IDF

    config ESP_WIFI_REMOTE_MAX_CONN_NUM
        int
        default 15

    config ESP_WIFI_SOFTAP_SUPPORT
        bool
        default y

    config ESP_WIFI_STATIC_RX_BUFFER_NUM
        int
        default 10

    config ESP_WIFI_DYNAMIC_RX_BUFFER_NUM
        int
        default 32

    config ESP_WIFI_TX_BUFFER_TYPE
        int
        default 1

    config ESP_WIFI_DYNAMIC_RX_MGMT_BUF
        int
        default 0

    config ESP_WIFI_ESPNOW_MAX_ENCRYPT_NUM
        int
        default 7

    endif # !ESP_WIFI_REMOTE_IN_IDF

endmenu
```

## firmware/boards/pai-touch/sdkconfig.defaults
```kconfig
CONFIG_IDF_TARGET_ESP32S3=y
CONFIG_ESPTOOLPY_FLASHSIZE_16MB=y
CONFIG_ESPTOOLPY_FLASHMODE_QIO=y
CONFIG_ESP_DEFAULT_CPU_FREQ_MHZ_240=y

CONFIG_PARTITION_TABLE_CUSTOM=y
CONFIG_PARTITION_TABLE_CUSTOM_FILENAME="boards/pai-touch/partitions.csv"
CONFIG_PARTITION_TABLE_OFFSET=0x8000

CONFIG_SPIRAM=y
CONFIG_SPIRAM_MODE_OCT=y
CONFIG_SPIRAM_SPEED_80M=y
CONFIG_SPIRAM_USE_MALLOC=y
CONFIG_SPIRAM_MALLOC_ALWAYSINTERNAL=0
CONFIG_SPIRAM_MALLOC_RESERVE_INTERNAL=8192
CONFIG_SPIRAM_TRY_ALLOCATE_WIFI_LWIP=y
CONFIG_SPIRAM_ALLOW_BSS_SEG_EXTERNAL_MEMORY=y
CONFIG_SPIRAM_ALLOW_NOINIT_SEG_EXTERNAL_MEMORY=y
CONFIG_SPIRAM_MEMTEST=n

CONFIG_COMPILER_OPTIMIZATION_PERF=y
CONFIG_COMPILER_CXX_EXCEPTIONS=y
CONFIG_COMPILER_CXX_RTTI=y
CONFIG_BOOTLOADER_COMPILER_OPTIMIZATION_PERF=y
CONFIG_ESP_CONSOLE_USB_SERIAL_JTAG=y
# app_main initializes the LVGL UI, FreeType faces, and the PXA runtime before
# it returns. Keep sufficient headroom for the combined startup call chain.
CONFIG_ESP_MAIN_TASK_STACK_SIZE=16384
# The Wi-Fi event handlers run on the default event loop task; 2304 bytes is
# too small and its overflow corrupts the loop mutex.
CONFIG_ESP_SYSTEM_EVENT_TASK_STACK_SIZE=4096
CONFIG_FREERTOS_HZ=1000
CONFIG_FREERTOS_USE_TRACE_FACILITY=n
CONFIG_FREERTOS_USE_STATS_FORMATTING_FUNCTIONS=n
CONFIG_FREERTOS_GENERATE_RUN_TIME_STATS=n

CONFIG_LITTLEFS_PAGE_SIZE=512
CONFIG_LITTLEFS_OBJ_NAME_LEN=96
CONFIG_LITTLEFS_READ_SIZE=256
CONFIG_LITTLEFS_WRITE_SIZE=256
CONFIG_LITTLEFS_LOOKAHEAD_SIZE=128
CONFIG_LITTLEFS_CACHE_SIZE=4096
CONFIG_LITTLEFS_BLOCK_CYCLES=256
CONFIG_LITTLEFS_MALLOC_STRATEGY_SPIRAM_PREFER=y

CONFIG_LV_OS_FREERTOS=y
CONFIG_LV_USE_CLIB_MALLOC=y
CONFIG_LV_USE_CLIB_STRING=y
CONFIG_LV_USE_CLIB_SPRINTF=y
CONFIG_LV_DEF_REFR_PERIOD=32
CONFIG_LV_DRAW_SW_DRAW_UNIT_CNT=1
CONFIG_LV_DRAW_THREAD_STACK_SIZE=32768
CONFIG_LV_USE_FREETYPE=y
CONFIG_LV_FREETYPE_USE_LVGL_PORT=n
CONFIG_LV_FREETYPE_CACHE_FT_GLYPH_CNT=2048
CONFIG_LV_FONT_MONTSERRAT_14=y
CONFIG_LV_FONT_MONTSERRAT_20=y
CONFIG_LV_USE_SNAPSHOT=y
CONFIG_LV_USE_LODEPNG=y

CONFIG_PXA_ENABLED=y
CONFIG_PXA_TRUST_BUNDLED_DEVELOPMENT_KEY=y
CONFIG_PXA_STORAGE_PARTITION_LABEL="pxa_data"
CONFIG_PXA_MOUNT_POINT="/pxa"
CONFIG_PXA_STORAGE_FORMAT_IF_MOUNT_FAILED=y
CONFIG_PXA_BUILTIN_PACKAGE_ROOT="system/pxa/factory"
CONFIG_PXA_STATE_ROOT="pxa-state"
CONFIG_PXA_WASI_LIBC=y
CONFIG_PXA_GUEST_STACK_SIZE=16384
CONFIG_PXA_HOST_MANAGED_HEAP_SIZE=16384
CONFIG_PXA_RUNTIME_TASK_STACK_SIZE=12288
CONFIG_PXA_RUNTIME_TASK_PRIORITY=3
CONFIG_PXA_RUNTIME_TASK_AFFINITY=0
# The App runtime is pinned to CPU0; split GameRender rasterization so the
# worker renders its row range on CPU1 concurrently.
CONFIG_PXA_PARALLEL_RASTER=y
CONFIG_PXA_RASTER_WORKER_AFFINITY=1
CONFIG_PXA_RASTER_WORKER_PRIORITY=4
CONFIG_PXA_RASTER_WORKER_STACK_SIZE=4096
CONFIG_PXA_CALL_TIMEOUT_MS=3000
CONFIG_PXA_PRIVATE_FS_QUOTA_BYTES=65536
CONFIG_PXA_PRIVATE_FS_MAX_OPEN_HANDLES=8

CONFIG_WAMR_ENABLE_AOT=y
CONFIG_WAMR_ENABLE_INTERP=y
CONFIG_WAMR_ENABLE_LIB_PTHREAD=y
CONFIG_WAMR_ENABLE_LIBC_BUILTIN=y
CONFIG_WAMR_ENABLE_LIBC_WASI=y
CONFIG_WAMR_ENABLE_REF_TYPES=y
CONFIG_WAMR_ENABLE_SHARED_MEMORY=y
CONFIG_WAMR_LINEAR_MEMORY_IN_PSRAM=y
CONFIG_WAMR_AOT_CODE_IN_PSRAM=y

CONFIG_PXSYS_REFERENCE_UI=y
CONFIG_PXSYS_REFERENCE_UI_STATUS_BAR=y
CONFIG_PXSYS_REFERENCE_UI_WIFI=y
CONFIG_PXSYS_REFERENCE_UI_BATTERY_PERCENT=y
CONFIG_PXSYS_REFERENCE_UI_NAVIGATION_BAR=y
CONFIG_PXSYS_REFERENCE_UI_NAVIGATION_GESTURES=y
CONFIG_PXSYS_REFERENCE_UI_GESTURE_HANDLE=y
CONFIG_PXSYS_REFERENCE_UI_LAUNCHER_COLUMNS=2
CONFIG_PXSYS_REFERENCE_UI_LAUNCHER_ROWS=2
CONFIG_PXSYS_REFERENCE_UI_NOTIFICATION_SHADE=y
CONFIG_PXSYS_REFERENCE_UI_WALLPAPER=n
CONFIG_PXSYS_REFERENCE_UI_ANIMATIONS=y
CONFIG_PXSYS_REFERENCE_UI_TASK_SWITCHER_CARDS=y
CONFIG_PXSYS_REFERENCE_UI_TASK_PREVIEW_COUNT=3

CONFIG_PXADB_ENABLED=y
CONFIG_PXADB_AUTOSTART=y
CONFIG_PXADB_TEST_CONTROL=y
```
