## firmware/components/pxa/Kconfig
```kconfig
menu "PXA Development Apps"
    depends on (IDF_TARGET_ESP32S3 || IDF_TARGET_ESP32S31) && !USE_EMOTE_MESSAGE_STYLE

    config PXA_ENABLED
        bool "Enable PXA Draft 0.1 platform"
        default n
        select LITTLEFS_SPIFFS_COMPAT
        select LITTLEFS_OPEN_DIR
        select LITTLEFS_FCNTL_GET_PATH
        select WAMR_LINEAR_MEMORY_RESERVE_MAX
        help
            Enable the PXA Draft 0.1 Core and signed Package platform.

    if PXA_ENABLED
        config PXA_STORAGE_PARTITION_LABEL
            string "PXA storage partition label"
            default "assets"
            help
                LittleFS partition used for PXA Packages, private state and
                optional factory content. This must match a data/littlefs
                partition in the selected board's partition table.

        config PXA_MOUNT_POINT
            string "PXA storage mount point"
            default "/assets"
            help
                Absolute VFS mount point for the PXA storage partition. Keep
                this unique and do not use a trailing slash.

        config PXA_STORAGE_FORMAT_IF_MOUNT_FAILED
            bool "Format an uninitialized PXA storage partition"
            default y
            help
                Format the PXA storage partition when LittleFS cannot mount
                it. This lets a firmware-only flash initialize an empty data
                partition for pxadb installation. Disable it when corrupted
                storage must never be reformatted automatically.

        config PXA_TRUST_BUNDLED_DEVELOPMENT_KEY
            bool "Trust the bundled PXA development signing key"
            default n
            help
                Development only. Trust the checked-in public key used to sign
                pxa-system/apps/pxa packages. Production firmware must leave this off and
                override pxa_platform_trusted_publishers() from a product-owned
                trust component.

        config PXA_BUILTIN_PACKAGE_ROOT
            string "Factory signed Package source relative to PXA storage"
            default "system/pxa/builtin"
            help
                Canonical product-owned source for factory-provisioned
                Packages. Apps are authenticated at boot and run in place.
                They may be disabled, but their source cannot be removed by
                App management.

        config PXA_STATE_ROOT
            string "Mutable PXA state root relative to PXA storage"
            default "pxa-state"
            help
                Root for the fixed inbox/, packages/ and data/ ownership
                domains. Keep it outside system/, tmp/ and .previous so normal
                factory-content provisioning does not replace App state.

        config PXA_RESOURCE_INTERNAL_BYTES
            int "Shared resource internal RAM budget"
            range 16384 262144
            default 131072
            help
                Global and active-package ceiling for charged allocations,
                including allocation prefixes and pending reservations.
                Covers raster objects, surface metadata and the audio device's
                task stacks, control blocks, queues and mutex. Other task
                stacks, DMA/frame buffers and platform heaps remain separate.

        config PXA_RESOURCE_EXTERNAL_BYTES
            int "Shared resource PSRAM budget"
            range 65536 8388608
            default 2097152
            help
                Shared by file textures, dynamic uploads, resource index/cache
                workspace, UI compressed images, short PCM, music buffers and
                audited codec allocation hooks, including the audio device's
                ring and cache metadata. No internal-RAM fallback. Decoded
                LVGL images and other platform allocations remain separate.

        config PXA_RESOURCE_TEMPORARY_INTERNAL_BYTES
            int "Shared temporary resource internal RAM ceiling"
            range 0 262144
            default 16384
            help
                Additional global ceiling for allocations classified TEMPORARY.
                Counts prefixes, concurrent jobs and old plus new resize blocks.
                Zero forbids temporary allocations in this memory class.
                This does not reserve RAM; the shared total ceiling also applies.

        config PXA_RESOURCE_TEMPORARY_EXTERNAL_BYTES
            int "Shared temporary resource PSRAM ceiling"
            range 0 8388608
            default 524288
            help
                Additional global ceiling for temporary decode buffers and
                audited codec allocations, across active and retiring owners.
                Counts allocation prefixes and old plus new resize blocks.
                Zero forbids temporary PSRAM allocations. Does not cover
                uncaptured third-party allocations or reserve capacity.

        config PXA_ASSET_EXTERNAL_BYTES
            int "File resource PSRAM object budget"
            range 65536 4194304
            default 524288
            help
                Includes final texture allocations, in-flight reservations and
                retired objects until their last frame reference is released.
                Index metadata, worker stack and other subsystems are separate.

        config PXA_ASSET_INTERNAL_BYTES
            int "File resource internal RAM object budget"
            range 1024 262144
            default 65536

        config PXA_ASSET_WORKER_STACK_SIZE
            int "Persistent resource worker stack bytes"
            range 4096 16384
            default 6144
            help
                One internal-RAM task shared across sequential activations.
                Runs below the audio decoder/output task priorities.

        config PXA_GUEST_STACK_SIZE
            int "Guest callback stack size"
            range 8192 131072
            default 16384

        config PXA_HOST_MANAGED_HEAP_SIZE
            int "WAMR host-managed heap size per Component"
            range 16384 524288
            default 16384
            help
                Size of the heap WAMR inserts into each Component's linear
                memory for Host-side temporary allocations, such as copying
                configuration and event payloads into the Guest. This is not
                the wasi-libc malloc heap or the Component's linear-memory
                limit.

        config PXA_WASI_LIBC
            bool "Enable capability-restricted WASI libc Apps"
            depends on WAMR_ENABLE_LIBC_WASI
            default y
            help
                Publish WASI Preview 1 reactor support. The base capability
                enables wasi-libc for pure computation only; ambient files,
                arguments, environment, clocks, randomness and stdio remain
                unavailable unless separately published by the Host.

        config PXA_RUNTIME_TASK_STACK_SIZE
            int "PXA runtime pthread stack size"
            range 6144 32768
            default 12288
            help
                Native stack reserved for the PXA owner pthread. The host
                raises lower values from an older sdkconfig to 12 KiB.

        config PXA_RUNTIME_TASK_PRIORITY
            int "PXA runtime pthread priority"
            range 1 10
            default 4

        config PXA_RUNTIME_TASK_AFFINITY
            int "PXA runtime pthread core affinity"
            range -1 1
            default -1
            help
                Pin the PXA owner pthread to CPU0 (0) or CPU1 (1). Use -1 to
                allow FreeRTOS to schedule it on either core. CPU1 is invalid
                on single-core targets.

        config PXA_PARALLEL_RASTER
            bool "Use a second core for GameRender rasterization"
            depends on !FREERTOS_UNICORE
            default n
            help
                Splits each validated draw list into disjoint horizontal row
                ranges. The caller renders one range while a pinned worker
                renders the other into the same color and depth buffers.

        config PXA_RASTER_WORKER_AFFINITY
            int "GameRender raster worker core affinity"
            depends on PXA_PARALLEL_RASTER
            range 0 1
            default 0

        config PXA_RASTER_WORKER_PRIORITY
            int "GameRender raster worker priority"
            depends on PXA_PARALLEL_RASTER
            range 1 10
            default 4

        config PXA_RASTER_WORKER_STACK_SIZE
            int "GameRender raster worker stack size"
            depends on PXA_PARALLEL_RASTER
            range 3072 8192
            default 4096

        config PXA_WATCHDOG_PERIOD_MS
            int "Guest callback watchdog poll period in milliseconds"
            range 10 250
            default 50
            help
                Poll the WAMR call deadline while the runtime is active. This
                only affects detection latency after PXA_CALL_TIMEOUT_MS; it
                does not shorten the configured callback timeout.

        config PXA_NET_WORKER_STACK_SIZE
            int "PXA HTTP(S) worker stack size"
            range 4096 16384
            default 8192
            help
                One external-RAM worker serializes PXA HTTP(S) requests so
                the PXA runtime task never waits for DNS, TLS, or network I/O.

        config PXA_COMMAND_QUEUE_LENGTH
            int "PXA runtime command queue length"
            range 8 64
            default 24

        config PXA_MAX_CONTROL_MESSAGE
            int "Maximum guest control message size"
            range 1024 16384
            default 4096

        config PXA_UI_DYNAMIC_BYTES
            int "Maximum retained PXA UI bytes"
            range 262144 8388608
            default 1048576
            help
                Shared byte budget for retained UI nodes, transaction data,
                Canvas frames and their allocation headers.

        config PXA_UI_TRANSACTION_BYTES
            int "Maximum PXA UI transaction bytes"
            range 4096 PXA_UI_DYNAMIC_BYTES
            default 262144

        config PXA_UI_CANVAS_BYTES
            int "Maximum PXA UI Canvas display-list bytes"
            range 4096 PXA_UI_DYNAMIC_BYTES
            default 262144

        config PXA_PRIVATE_FS_QUOTA_BYTES
            int "Per-App private FS quota in bytes"
            range 4096 16777216
            default 65536
            help
                Logical regular-file byte quota for one signed PXA App identity.
                This is a disk limit, not a RAM allocation or reserved disk space.
                Actual downloads remain limited by free filesystem capacity.

        config PXA_STORE_ORIGIN
            string "Trusted HTTPS origin for Host-managed App Store downloads"
            default "https://app.doit.am"
            help
                Host only downloads signed PXA containers from this origin.
                Keep it aligned with the Store App catalog origin.

        config PXA_PRIVATE_FS_MAX_OPEN_HANDLES
            int "Per-App private FS open Handle limit"
            range 1 32
            default 8
            help
                Combined limit for active private file and directory Handles.

        config PXA_PRIVATE_KV_QUOTA_BYTES
            int "Per-App private KV value quota in bytes"
            range 1024 65536
            default 8192
            help
                Sum of Storage v1 value bytes for one signed PXA App identity.

        config PXA_PRIVATE_KV_MAX_VALUE_BYTES
            int "Private KV maximum value size in bytes"
            range 64 960
            default 960
            help
                Maximum byte-string value accepted by one Storage v1 set request.

        config PXA_CALL_TIMEOUT_MS
            int "Guest callback deadline in milliseconds"
            range 10 20000
            default 3000
    endif
endmenu
```

## firmware/components/pxa_render_accel/Kconfig
```kconfig
menu "PXA rendering acceleration"
    config PXA_RENDER_ACCEL
        bool "Use ESP32-S31 rendering acceleration"
        depends on IDF_TARGET_ESP32S31
        default y
        help
            Shared SIMD pixel primitives and PPA bulk operations for LVGL,
            PXA GameRender and board presenters. Unsupported operations retain
            the scalar renderer. Disable for performance comparisons.

    config PXA_RENDER_ACCEL_INDEX8
        bool "Use PPA for native INDEX8 GameRender blits"
        depends on PXA_RENDER_ACCEL
        default n
        help
            Experimental. Palette setup and synchronization can cost more than
            CPU lookup. Enable only after measuring the intended workload.

    config PXA_RENDER_ACCEL_SELF_TEST
        bool "Include rendering acceleration differential tests"
        depends on PXA_RENDER_ACCEL
        default n
        help
            Enable the PXADB PERF ACCELTEST developer command when PXADB test
            control is enabled. Tests run explicitly, never during startup.
endmenu
```
