## firmware/boards/esp-mosaico/Kconfig.projbuild
```kconfig
menu "ESP-Mosaico peripherals"

config PXA_MOSAICO_LCD_PSRAM_DMA_DIRECT
    bool "Send contiguous output rows directly from PSRAM"
    default y
    help
        Reuse aligned, immutable scanout rows as SPI DMA input, as on
        DOIT GameKit 1. Narrow strided windows retain internal staging.
        Disable to use the original two internal staging buffers throughout.

config PXA_MOSAICO_LCD_COMPACT_UI
    bool "Use a 32-row LVGL draw buffer"
    default n
    help
        Render UI patches into a panel-owned snapshot. This releases
        420 KiB of PSRAM for large decoder reference pictures on the H264 build.

config PXA_MOSAICO_LCD_STAGING_ROWS
    int "Internal DMA staging capacity in full-width rows per buffer"
    range 1 16
    default 4 if PXA_MOSAICO_LCD_PSRAM_DMA_DIRECT
    default 16
    help
        Each row reserves 960 bytes in each of the two staging buffers.
        Narrow rectangles can pack up to 16 rows per transfer. Aligned
        full-width frames use direct PSRAM DMA at the usual transaction size.
        Larger buffers reduce transactions for wide strided windows.

config PXA_MOSAICO_NAND_FORMAT_IF_MOUNT_FAILED
    bool "Automatically initialize onboard NAND without a filesystem"
    default y
    help
        On startup, probe the onboard NAND and create a Dhara-backed FAT
        filesystem when FatFS reports FR_NO_FILESYSTEM. This erases existing
        content not recognized as a FAT filesystem. Valid filesystems mount
        directly. I/O failures and other probe errors do not trigger a format.
        Disable this option to preserve unrecognized NAND content.

endmenu
```

## firmware/components/pxa_video_codecs/tests/raw-bench/sdkconfig.defaults
```kconfig
CONFIG_ESP_DEFAULT_CPU_FREQ_MHZ_320=y
CONFIG_ESPTOOLPY_FLASHMODE_DIO=y
CONFIG_ESPTOOLPY_FLASHFREQ_80M=y
CONFIG_ESPTOOLPY_FLASHSIZE_16MB=y
CONFIG_PARTITION_TABLE_CUSTOM=y
CONFIG_PARTITION_TABLE_CUSTOM_FILENAME="../../../../boards/esp-mosaico/partitions.csv"
CONFIG_COMPILER_OPTIMIZATION_SIZE=y
CONFIG_SPIRAM=y
CONFIG_SPIRAM_MODE_OCT=y
CONFIG_SPIRAM_SPEED_250M=y
CONFIG_SPIRAM_MALLOC_ALWAYSINTERNAL=0
CONFIG_SPIRAM_MALLOC_RESERVE_INTERNAL=262144
CONFIG_FREERTOS_HZ=1000
CONFIG_FREERTOS_TASK_CREATE_ALLOW_EXT_MEM=y
CONFIG_ESP_MAIN_TASK_STACK_SIZE=16384
# CONFIG_ESP_TASK_WDT_CHECK_IDLE_TASK_CPU0 is not set
# CONFIG_ESP_TASK_WDT_CHECK_IDLE_TASK_CPU1 is not set
CONFIG_TINYUSB_CDC_ENABLED=y
CONFIG_TINYUSB_CDC_COUNT=1
CONFIG_TINYUSB_CDC_RX_BUFSIZE=512
CONFIG_TINYUSB_CDC_TX_BUFSIZE=1024
CONFIG_TINYUSB_CDC_EP_BUFSIZE=512
CONFIG_ESP_OPENH264_PROFILE_MINIMAL=y
CONFIG_ESP_OPENH264_LOG_LEVEL_WARN=y
```

## firmware/components/pxadb/Kconfig
```kconfig
menu "PXADB development service"

    config PXADB_ENABLED
        bool "Enable PXADB development service"
        depends on IDF_TARGET_ESP32S3 || IDF_TARGET_ESP32S31 || IDF_TARGET_ESP32P4
        default n
        help
            Expose PXADB control, PXA package management, filesystem access
            and structured logs over the selected transport. It does not
            expose a shell or raw flash access.

    choice PXADB_TRANSPORT
        prompt "Primary PXADB transport"
        depends on PXADB_ENABLED
        default PXADB_TRANSPORT_USB_SERIAL_JTAG
        help
            USB Serial/JTAG is the ESP32-S3 native port. Boards whose native
            USB port is not wired (the service is tunnelled through a USB-UART
            bridge instead) can run PXADB over a UART. With a UART transport,
            console log text shares the same line and the host client skips
            lines that are not PXADB frames.

        config PXADB_TRANSPORT_USB_SERIAL_JTAG
            bool "USB Serial/JTAG"

        config PXADB_TRANSPORT_UART
            bool "UART"

        config PXADB_TRANSPORT_USB_CDC
            bool "USB OTG CDC (board-initialized TinyUSB)"
            depends on SOC_USB_OTG_SUPPORTED
            help
                The board must initialize TinyUSB CDC ACM interface 0 before
                starting PXADB. Console output may share this interface.
    endchoice

    config PXADB_UART_SECONDARY
        bool "Also expose PXADB on UART"
        depends on PXADB_ENABLED && !PXADB_TRANSPORT_UART
        default n
        help
            Keep native USB and UART available at the same time. Each endpoint
            has its own parser, uploads, log subscription and system-write
            unlock. Package transfers share a device-wide mutation lease.
            Both endpoints use one control task to preserve internal SRAM.
            Only enable this on a UART/pin pair reserved by the board for debug.

    config PXADB_UART_PORT
        int "PXADB UART port"
        range 0 2
        default 0
        depends on PXADB_ENABLED && (PXADB_TRANSPORT_UART || PXADB_UART_SECONDARY)

    config PXADB_UART_TX_GPIO
        int "PXADB UART TX GPIO (-1 keeps the console default)"
        default -1
        depends on PXADB_ENABLED && (PXADB_TRANSPORT_UART || PXADB_UART_SECONDARY)

    config PXADB_UART_RX_GPIO
        int "PXADB UART RX GPIO (-1 keeps the console default)"
        default -1
        depends on PXADB_ENABLED && (PXADB_TRANSPORT_UART || PXADB_UART_SECONDARY)

    config PXADB_UART_BAUD
        int "PXADB UART baud rate"
        default 115200
        depends on PXADB_ENABLED && (PXADB_TRANSPORT_UART || PXADB_UART_SECONDARY)

    config PXADB_UART_TX_BURST_BYTES
        int "Maximum UART transmit burst (0 disables pacing)"
        range 0 1024
        default 0
        depends on PXADB_ENABLED && (PXADB_TRANSPORT_UART || PXADB_UART_SECONDARY)
        help
            Limit each reply write and drain the preceding burst before
            sending the next. USB-UART bridges without hardware flow control
            can need this at high rates. Zero keeps continuous transmission;
            native USB is not paced.

    config PXADB_UART_TX_GAP_US
        int "Idle time between UART transmit bursts (microseconds)"
        range 0 10000
        default 100
        depends on PXADB_ENABLED && (PXADB_TRANSPORT_UART || PXADB_UART_SECONDARY) && PXADB_UART_TX_BURST_BYTES > 0
        help
            Allow the USB-UART receiver to drain its buffer after the preceding
            bytes have left the UART. This pause applies to PXADB replies.

    config PXADB_AUTOSTART
        bool "Enable PXADB at boot by default"
        depends on PXADB_ENABLED
        default y
        help
            Select the initial PXADB preference when it has not been saved.
            The user's PXADB switch in Settings is saved and takes precedence
            on subsequent normal boots.

    config PXADB_LAN
        bool "Offer Wi-Fi PXADB from Developer options"
        depends on PXADB_ENABLED && MBEDTLS_TLS_ENABLED && MBEDTLS_SSL_PROTO_TLS1_2
        default y
        select MBEDTLS_PSK_MODES
        select MBEDTLS_KEY_EXCHANGE_PSK
        select ESP_PROTOCOMM_SUPPORT_SECURITY_VERSION_2
        help
            Add an optional TLS endpoint on the station network. It is off
            at boot and uses a fresh six-digit code to authenticate an SRP
            key exchange before TLS.

    config PXADB_TASK_STACK_SIZE
        int "PXADB control task stack size (bytes)"
        range 16384 32768
        default 20480
        depends on PXADB_ENABLED
        help
            Internal-memory stack for package verification, filesystem access
            and screenshot encoding. Boards may tune this after measuring
            high-water marks with deployment and capture workloads. The
            stack stays internal because filesystem operations write flash.

    config PXADB_LOG_HISTORY_DEPTH
        int "PXADB retained log records"
        range 0 64
        default 16
        depends on PXADB_ENABLED
        help
            Internal-memory history replayed when logcat connects. Live log
            streaming uses its separate bounded queue. Zero disables history
            allocation and copying while preserving live logs. Boards with camera DMA
            requirements can retain fewer records to preserve internal memory.

    config PXADB_TEST_CONTROL
        bool "Enable input injection and display capture"
        depends on PXADB_ENABLED
        default n
        help
            Enable logical input injection and RGB565 capture commands. The
            product must configure a pxadb::TestControlAdapter before starting
            the service; unavailable controls are not advertised to the host.

    config PXADB_CAPTURE_MIN_INTERVAL_MS
        int "Minimum interval between screenshot captures (ms)"
        range 0 10000
        default 250
        depends on PXADB_TEST_CONTROL
        help
            Screenshot requests faster than this are rejected with
            screenshot_rate_limited. Device-encoded JPEG captures are much
            cheaper than RGB565 bursts, so a lower value gives a smoother
            preview when the host asks for JPEG frames.

    config PXADB_JPEG_PSRAM_WORKSPACE
        bool "Prefer PSRAM for large screenshot encoder workspaces"
        depends on PXADB_TEST_CONTROL && SPIRAM
        default n
        help
            Prefer PSRAM for encoder allocations of at least 4096 bytes on
            the screenshot thread, with the vendor allocator as fallback.
            Other threads, including UI image decoding, retain defaults.
            No cache or helper task remains after capture. This isolates
            two private esp_new_jpeg 1.0.2 allocation symbols; upgrades
            require capture and memory regressions. Output capacity remains
            conservative because undersized outputs can corrupt the heap.

endmenu
```

## tools/system-comparison/aster/pai-touch/main/Kconfig.projbuild
```kconfig
config ASTER_P4_DUAL_CORE_RENDER
    bool "Use existing Aster dual-core pixel worker on Pai Touch"
    default y
config ASTER_P4_AUTORUN_DIAGNOSTIC
    bool
    default n
```

## tools/system-comparison/aster/pai-touch/sdkconfig.defaults
```kconfig
CONFIG_IDF_TARGET="esp32s3"
CONFIG_ESPTOOLPY_FLASHSIZE_16MB=y
CONFIG_ESPTOOLPY_FLASHMODE_QIO=y
CONFIG_ESP_DEFAULT_CPU_FREQ_MHZ_240=y
CONFIG_SPIRAM=y
CONFIG_SPIRAM_MODE_OCT=y
CONFIG_SPIRAM_SPEED_80M=y
CONFIG_SPIRAM_USE_MALLOC=y
CONFIG_SPIRAM_FETCH_INSTRUCTIONS=n
CONFIG_SPIRAM_RODATA=n
CONFIG_SPIRAM_MALLOC_ALWAYSINTERNAL=0
CONFIG_SPIRAM_MALLOC_RESERVE_INTERNAL=32768
CONFIG_SPIRAM_ALLOW_BSS_SEG_EXTERNAL_MEMORY=y
CONFIG_SPIRAM_ALLOW_NOINIT_SEG_EXTERNAL_MEMORY=y
CONFIG_ESP32S3_INSTRUCTION_CACHE_16KB=y
CONFIG_ESP32S3_DATA_CACHE_LINE_64B=y
CONFIG_ESP_MAIN_TASK_STACK_SIZE=16384
CONFIG_COMPILER_OPTIMIZATION_PERF=y
CONFIG_ESP_CONSOLE_USB_SERIAL_JTAG=y
CONFIG_FREERTOS_HZ=1000
CONFIG_PARTITION_TABLE_CUSTOM=y
CONFIG_PARTITION_TABLE_CUSTOM_FILENAME="partitions.csv"
CONFIG_FATFS_LFN_HEAP=y
CONFIG_FATFS_MAX_LFN=255
CONFIG_FATFS_API_ENCODING_UTF_8=y
CONFIG_FATFS_SECTOR_4096=y
CONFIG_WAMR_ENABLE_INTERP=n
CONFIG_WAMR_ENABLE_AOT=y
CONFIG_WAMR_ENABLE_SHARED_MEMORY=y
CONFIG_WAMR_ENABLE_LIBC_WASI=n
CONFIG_WAMR_ENABLE_LIB_PTHREAD=n
CONFIG_MBEDTLS_EXTERNAL_MEM_ALLOC=y
CONFIG_ASTER_P4_DUAL_CORE_RENDER=y
```
